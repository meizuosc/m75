## kernel/drivers/motor/Kconfig
```kconfig
menu "Motor Ti drv2605 drivers"
	depends on ANDROID_TIMED_OUTPUT

config MOTOR_DRV2605
	tristate "Support Ti drv2605 motor"
	depends on ANDROID_TIMED_OUTPUT
endmenu 
```

## kernel/drivers/staging/iio/imu/inv_mpu/Kconfig
```kconfig
#
# inv-mpu-iio driver for Invensense MPU devices and combos
#

config INV_MPU_IIO
	tristate "Invensense MPU devices"
	depends on I2C && SYSFS && IIO && IIO_KFIFO_BUF && IIO_TRIGGER && !INV_MPU
	default n
	help
	  This driver supports the Invensense ICM20728/ICM20628 devices.
	  This driver can be built as a module. The module will be called
	  inv-mpu-iio.

config DTS_INV_MPU_IIO
	bool  "Invensense MPU driver using Device Tree Structure (DTS)"
	depends on INV_MPU_IIO
	default n
	help
	  This enables Invensense MPU devices to use Device Tree Structure.
	  DTS must be enabled in the system.

config INV_MPU_IIO_SPI
	tristate "Invensense MPU device on SPI bus"
	depends on SPI && SYSFS && IIO && IIO_KFIFO_BUF && IIO_TRIGGER && !INV_MPU && !INV_MPU_IIO && !DTS_INV_MPU_IIO
	default n
        help
          This driver supports the Invensense ICM20728/ICM20628 devices.
          This driver can be built as a module. The module will be called
          inv-mpu-iio.
```

## kernel/sound/soc/codecs/audience/Kconfig
```kconfig
menu "Audience earSmart Audio chip"

config SND_SOC_ES325
        bool "eS325"
	---help---
	  Enable support for Audience eS325 audio chip
	  Possible control+data and high bandwidth bus combinations:
	  * I2C+I2S and UART
	  * SPI+I2S and UART
	  * SLIMbus + SLIMbus and UART
	  * I2C+I2S and SPI

config SND_SOC_ES515
        bool "eS515"
	---help---
	  Enable support for Audience eS515 audio chip
	  Possible control+data and high bandwidth bus combinations:
	  * I2C+I2S and UART
	  * SPI+I2S and UART
	  * SLIMbus + SLIMbus and UART
	  * I2C+I2S and SPI

config SND_SOC_ES705
        bool "eS705"
	---help---
	  Enable support for Audience eS705 audio chip
	  Possible control+data and high bandwidth bus combinations:
	  * I2C+I2S and UART
	  * SPI+I2S and UART
	  * SLIMbus + SLIMbus and UART
	  * I2C+I2S and SPI

config SND_SOC_ES705_ESCORE
        bool "eS705_escore"
	select SND_SOC_ES_VS
	---help---
	  Enable support for Audience eS705 audio chip escore
	  Possible control+data and high bandwidth bus combinations:
	  * I2C+I2S and UART
	  * SPI+I2S and UART
	  * SLIMbus + SLIMbus and UART
	  * I2C+I2S and SPI

config SND_SOC_ES755
        bool "eS755"
	select SND_SOC_ES_VS
	---help---
	  Enable support for Audience eS755 audio chip
	  Possible control+data and high bandwidth bus combinations:
	  * I2C+I2S and UART
	  * SPI+I2S and UART
	  * SLIMbus + SLIMbus and UART
	  * I2C+I2S and SPI

# Legacy config options for eS705

if SND_SOC_ES705

config SND_SOC_ES705_I2S
	tristate

choice
	prompt "eS705 Command Interface"
	default SND_SOC_ES705_SLIM

config SND_SOC_ES705_SLIM
	bool "SLIMbus based audio processor" if SLIMBUS
	---help---
	  This enables SLIMbus as control interface
	  as well as data interface to communicate
	  with firmware. Using SLIMbus only as a control
	  interface is not supported.

config SND_SOC_ES705_I2C
	bool "I2C based audio processor"
	select SND_SOC_ES705_I2S
	---help---
	  This enabled I2C as control interface. For data
	  interface I2S will be selecte as
	  default audio data interface. SLIMbus as a data interface
	  is not supported in combination with I2C as control
	  interface.

config SND_SOC_ES705_SPI
	bool "SPI based audio processor"
	select SND_SOC_ES705_I2S
	---help---
	  This enabled SPI as control interface. For data
	  interface I2S will be selecte as
	  default audio data interface. SLIMbus as a data interface
	  is not supported in combination with SPI as control
	  interface.

config SND_SOC_ES705_UART
        bool "UART based audio processor"
	select SND_SOC_ES705_I2S
        ---help---
	  This enabled UART as control interface. For data
	  interface I2S will be selecte as
	  default audio data interface. SLIMbus as a data interface
	  is not supported in combination with SPI as control
	  interface.

endchoice

choice
	prompt "Datablock Read/Write Transport"
	default SND_SOC_ES705_DATABLOCK_DEFAULT

config SND_SOC_ES705_DATABLOCK_BUS_DEFAULT
	bool "Default control interface"
	---help---
	  Default control interface will be used
	  for read datablock and write data block.
	  This is used when datablock read and write
	  done using earSmart character device.

config SND_SOC_ES705_DATABLOCK_BUS_SLIM
	bool "SLIMbus" if SND_SOC_ES705_SLIM
	---help---
	  SLIMbus interface will be used for read datablock and
	  write data block.
	  This is used when datablock read and write
	  done using earSmart character device.

config SND_SOC_ES705_DATABLOCK_BUS_UART
	bool "UART high bandwidth transport"
	---help---
	  UART interface will be used for read datablock and
	  write data block.
endchoice
endif

config SND_SOC_ES705_UART_FW_DOWNLOAD
	depends on SND_SOC_ES705_SLIM
	bool "BOSKO and VS firmware download over UART"
	---help---
	  Enable BOSKO and VS fimware downlaod over UART and command
	  will remain as Slimbus.
	  This is used for faster download of firmware over UART
	  on higher baudrates.

config SND_SOC_ES705_UART_WAKEUP
	depends on SND_SOC_ES705
	bool "ES705 wakeup over UART"
	---help---
	Ebabling this feature uses UART TX of host to wakeup eS705
	instead of wakeup gpio.

config MQ100_SENSOR_HUB
        bool "MQ100 Sensor driver support"
		depends on SND_SOC_ES705
	---help---
	  This will enable MQ100 sensor hub configuration

config SND_SOC_ES705_EXTCLK_OVER_GPIO
	bool "Enable External Clock Control Over GPIO"
	---help---
	  This will enable external clock ON/OFF over GPIO

config SND_SOC_ES705_CLOCK_INDEX
	depends on SND_SOC_ES705
	prompt "Audience es705 clock's index"
	int
	default 8
	---help---
	  Defines Audience es705 clock's index.
	  Supported clocks indexes
	  * 0 for 9600 MHz
	  * 8 for 19200 MHz

# Options for escore infrastructure

if SND_SOC_ES325 || SND_SOC_ES515 || SND_SOC_ES755 || SND_SOC_ES705_ESCORE

config SND_SOC_ES_I2S
	tristate

choice
	prompt "Command Interface"
	default SND_SOC_ES_SLIM

config SND_SOC_ES_SLIM
	bool "SLIMbus based codec" if SLIMBUS
	select SND_SOC_ES_WAKEUP_UART
	---help---
	  This enables SLIMbus as control interface
	  as well as data interface to communicate
	  with firmware. Using SLIMbus only as a control
	  interface is not supported.

config SND_SOC_ES_I2C
	bool "I2C based codec"
	select SND_SOC_ES_I2S
	---help---
	  This enabled I2C as control interface. For data
	  interface I2S will be selecte as
	  default audio data interface. SLIMbus as a data interface
	  is not supported in combination with I2C as control
	  interface.

config SND_SOC_ES_SPI
	bool "SPI based codec"
	select SND_SOC_ES_WAKEUP_GPIO
	select SND_SOC_ES_I2S
	---help---
	  This enabled SPI as control interface. For data
	  interface I2S will be selecte as
	  default audio data interface. SLIMbus as a data interface
	  is not supported in combination with SPI as control
	  interface.

config SND_SOC_ES_UART
	select SND_SOC_ES_WAKEUP_UART
        bool "UART based codec"
	select SND_SOC_ES_CDEV
	select SND_SOC_ES_I2S
        ---help---
	  This enabled SPI as control interface. For data
	  interface I2S will be selecte as
	  default audio data interface. SLIMbus as a data interface
	  is not supported in combination with SPI as control
	  interface.

endchoice
endif

# High bandwidth bus support
if SND_SOC_325 || SND_SOC_ES515 || SND_SOC_ES755 || SND_SOC_ES705_ESCORE
choice
	prompt "High Bandwidth Transport"
	default SND_SOC_ES_HIGH_BW_BUS_DEFAULT

config SND_SOC_ES_HIGH_BW_BUS_DEFAULT
	bool "Default control interface"
	---help---
	  Default control interface will be used
	  as high bandwidth bus interface. High bandwidth
	  bus interface will primarily be used to
	  download the firmware on audio processor.

config SND_SOC_ES_HIGH_BW_BUS_SLIM
	bool "SLIMbus" if SND_SOC_ES_SLIM || SND_SOC_ES705_SLIM
	---help---
	  SLIMbus will be used to load firmware on chip.
	  High bandwidth  bus interface will primarily
	  be used to download the firmware on earSmart
	  audio processor.

config SND_SOC_ES_HIGH_BW_BUS_I2C
	bool "I2C high bandwidth bus"
	---help---
	  I2C will be used to load firmware on chip.
	  High bandwidth  bus interface will primarily
	  be used to download the firmware on earSmart
	  audio processor.

config SND_SOC_ES_HIGH_BW_BUS_SPI
	bool "SPI high bandwidth bus"
	---help---
	  SPI will be used to load firmware on chip.
	  High bandwidth  bus interface will primarily
	  be used to download the firmware on earSmart
	  audio processor.

config SND_SOC_ES_HIGH_BW_BUS_UART
	select SND_SOC_ES_WAKEUP_UART
	bool "UART high bandwidth transport"
	---help---
	  UART will be used to load firmware on chip.
	  High bandwidth  bus interface will primarily
	  be used to download the firmware on earSmart
	  audio processor.
endchoice
endif

# Should be used in eS325 driver to use different baud rates
# for multi stage firmware download
config SND_SOC_ES_1ST_STAGE_UART_BAUD
	depends on SND_SOC_ES_HIGH_BW_BUS_UART && SND_SOC_ES325
	prompt "UART baud rate for 1st stage firmware download"
	int
	default 28800
	---help---
	  Supported buad rates
	  * 19200
	  * 28800
	  * 38400
	  * 57600

config SND_SOC_ES_2ND_STAGE_UART_BAUD
	depends on SND_SOC_ES_HIGH_BW_BUS_UART && SND_SOC_ES325
	prompt "UART baud rate for 2nd stage firmware download"
	int
	default 1000000
	---help---
	  Supported buad rates
	  * 921600
	  * 1000000
	  * 2000000
	  * 3000000
	  The 1st stage firmware will contain the information about the baud
	  rate for 2nd stage download.

config SND_SOC_ES_UARTHS_BAUD
	depends on SND_SOC_ES_HIGH_BW_BUS_UART && (SND_SOC_ES755 || SND_SOC_ES705 || SND_SOC_ES705_ESCORE)
	prompt "UART baud rate for firmware download"
	int
	default 3072000
	---help---
	  Supported buad rates
	  * 460800
	  * 921600
	  * 1000000
	  * 1024000
	  * 1152000
	  * 2000000
	  * 2048000
	  * 3000000
	  * 3072000

config SND_SOC_ES_CDEV
        bool "Character device interface"
	---help---
	The character device interface allows the streaming out the audio
	data through selected Bus interface. Three nodes created under /dev
	provide following features:
	* /dev/adnc0 --> Alternate command interface to firmware
	* /dev/adnc1 --> Download firmware runtime
	* /dev/adnc2 --> Stream out debug audio stream

choice
	prompt "Streming Device Interface"
	depends on SND_SOC_ES_CDEV
	default SND_SOC_ES_STREAMDEV_DEFAULT

config SND_SOC_ES_STREAMDEV_DEFAULT
        bool "Default streaming interface"
	---help---
	earSmart chip supports streaming over different interfaces.
	Many interfaces can be used for streaming.
	This option selects default control interface for streaming.
	Interface. Streaming audio data will be sent over control interface.

config SND_SOC_ES_SLIM_STREAMDEV
        bool "SLIM streaming interface"
	---help---
	earSmart chip supports streaming over different interfaces.
	Many interfaces can be used for streaming.
	This option selects SLIMbus interface for streaming.
	Interface. Streaming audio data will be sent over SLIMbus interface.

config SND_SOC_ES_I2C_STREAMDEV
        bool "I2C streaming interface"
	---help---
	earSmart chip supports streaming over different interfaces.
	Many interfaces can be used for streaming.
	This option selects I2C interface for streaming.
	Interface. Streaming audio data will be sent over I2C interface.

config SND_SOC_ES_SPI_STREAMDEV
        bool "SPI streaming interface"
	---help---
	earSmart chip supports streaming over different interfaces.
	Many interfaces can be used for streaming.
	This option selects SPI interface for streaming.
	Interface. Streaming audio data will be sent over SPI interface.

config SND_SOC_ES_UART_STREAMDEV
	select SND_SOC_ES_WAKEUP_UART
        bool "UART streaming interface"
	---help---
	earSmart chip supports streaming over different interfaces.
	Many interfaces can be used for streaming.
	This option selects UART interface for streaming.
	Interface. Streaming audio data will be sent over UART interface.

endchoice

config SND_SOC_ES_VS
        bool "Voice Sense feature"
	depends on SND_SOC_ES705 || SND_SOC_ES705_ESCORE || SND_SOC_ES755 || SND_SOC_ES325
	---help---
	This allows to select VS feature

config SND_SOC_ES755_A1
	bool "A1 revision of eS755 chip"
	depends on SND_SOC_ES755 && SND_SOC_ES_SLIM
	---help---
	Enables the support for A1 revision of eS755 chip.

config SND_SOC_ES_WAKEUP_GPIO
	tristate

config SND_SOC_ES_WAKEUP_UART
	tristate

endmenu
```

## kernel/sound/soc/mediatek/Kconfig
```kconfig
config MT_SND_SOC_V1
    bool "MT_SND_SOC_V1"
    default y
    help
        If you say Y, enable MT_SND_SOC_V1_driver.

config MTK_SPEAKER
    bool "MTK_SPEAKER"
    default y
    help
        If you say Y, enable MTK_SPEAKER_AMP
        
config MTK_NXP_TFA9890
    bool "MTK_NXP_TFA9890"
    default n
    help
        If you say Y, enable MTK_NXP_TFA9890 driver.
```
